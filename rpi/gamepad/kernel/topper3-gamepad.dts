/dts-v1/;
/plugin/;

/ {
    compatible = "brcm,bcm2835";

    fragment@0 {
        target = <&i2c1>;
        __overlay__ {
            #address-cells = <1>;
            #size-cells = <0>;
            status = "okay";

            topper3_gamepad: gamepad@30 {
                compatible = "othermod,topper3-gamepad";
                reg = <0x30>;
                status = "okay";

                /* Optional properties with defaults if not specified */
                poll-interval-ms = <10>;  /* Polling interval in milliseconds (default: 10) */
                axis-minimum = <0>;       /* Minimum axis value (default: 0) */
                axis-maximum = <255>;     /* Maximum axis value (default: 255) */
                axis-fuzz = <0>;          /* Axis fuzz tolerance (default: 0) */
                axis-flat = <0>;          /* Axis flat/deadzone (default: 0) */

                /* CRC verification (enabled by default, uncomment to disable) */
                /* disable-crc; */
            };
        };
    };
};
