/dts-v1/;
/plugin/;

/ {
    compatible = "brcm,bcm2835";

    fragment@0 {
        target = <&i2c1>;
        __overlay__ {
            #address-cells = <1>;
            #size-cells = <0>;
            status = "okay";

            topper3_gamepad: gamepad@30 {
                compatible = "othermod,topper3-gamepad";
                reg = <0x30>;
                status = "okay";
                
                /* Optional properties with defaults if not specified */
                axis-minimum = <0>;     /* default: 0 */
                axis-maximum = <255>;   /* default: 255 */
                axis-fuzz = <0>;        /* default: 0 */
                axis-flat = <0>;        /* default: 0 */
                poll-interval-ms = <10>; /* default: 10 */
            };
        };
    };
};